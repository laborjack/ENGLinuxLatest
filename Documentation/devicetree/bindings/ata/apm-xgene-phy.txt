## Documentation/devicetree/bindings/ata/apm-xgene-phy.txt
```
* APM X-Gene 6.0 Gb/s SATA PHY nodes

SATA PHY nodes are defined to describe on-chip Serial ATA PHY. Each SATA PHY
(pair of PHY) has its own node.

Required properties:
- compatible		: Shall be "apm,xgene-ahci-phy" or
			  "apm,xgene-ahci-phy2". The "apm,xgene-ahci-phy"
			  describes an port shared with SGMII Ethernet port.
			  The "apm,xgene-ahci-phy2" describes an port not
			  shared with SGMII and the PLL located at another
			  memory resource region.
- reg			: First PHY memory resource
			  Second separate PHY PLL clock memory resource if
			  type "apm,xgene-ahci-phy2"
- #phy-cells		: Shall be 0

Optional properties:
- status		: Shall be "ok" if enabled or "na" if disabled. Default
			  is "ok".
- txeyetuning		: Manual control to fine tune the capture of the serial
			  bit lines from the automatic calibrated position.
			  Two set of 3-tuple setting for Gen1, Gen2, and Gen3.
			  Range from 0 to 0x7f. Default is 0xa.
- txeyedirection	: Eye tuning manual control direction. 0 means sample
			  data earlier than the nominal sampling point. 1 means
			  sample data later than the nominal sampling point.
			  Two set of 3-tuple setting for Gen1, Gen2, and Gen3.
			  Default is 0x0.
- txboostgain		: Frequency boost and DC gain control. Two set of
			  3-tuple setting for Gen1, Gen2, and Gen3. Range is
			  between 0 to 0x1f. Default is 0x3.
- txspeed		: Tx operating speed. Two set of 3-tuple for
			  Gen1 (0x1), Gen2 (0x3), and Gen3 (0x7). Default is
			  0x7.

NOTE: PHY override parameters are board specific setting.

Example:
		sataphy0: sataphy@1f210000 {
			compatible = "apm,xgene-ahci-phy";
			reg = <0x0 0x1f210000 0x0 0x10000>;
			#phy-cells = <0>;
			status = "na";
		};

		sataphy1: sataphy@1f220000 {
			compatible = "apm,xgene-ahci-phy";
			reg = <0x0 0x1f220000 0x0 0x10000>;
			#phy-cells = <0>;
			status = "ok";
		};

		sataphy2: sataphy@1f230000 {
			compatible = "apm,xgene-ahci-phy2";
			reg = <0x0 0x1f230000 0x0 0x10000
			       0x0 0x1f2d0000 0x0 0x10000 >;
			#phy-cells = <0>;
			status = "ok";
		};
```

## Documentation/devicetree/bindings/ata/apm-xgene.txt
```
* APM X-Gene 6.0 Gb/s SATA host controller nodes

SATA host controller nodes are defined to describe on-chip Serial ATA
controllers. Each SATA controller (pair of ports) have its own node.

Required properties:
- compatible		: Shall be "apm,xgene-ahci"
- reg			: First memory resource shall be the AHCI memory
			  resource.
			  Second memory resource shall be the host controller
			  memory resource.
- interrupt-parent	: Interrupt controller
- interrupts		: Interrupt mapping for SATA host controller IRQ
- clocks		: Reference to the clock entry
- phys			: PHY reference
- phy-names		: Name of the PHY reference. The name should be
			  formed by "sataphy" plus lower case hex for the
			  lower 32-bit PHY CSR address (2nd memory resource)

Optional properties:
- status		: Shall be "ok" if enabled or "na" if disabled.
			  Default is "ok".

Example:
		sata0: sata@1a000000 {
			compatible = "apm,xgene-ahci";
			reg =  <0x0 0x1a000000 0x0 0x100000
				0x0 0x1f210000 0x0 0x10000>;
			interrupt-parent = <&gic>;
			interrupts = <0x0 0x86 0x4>;
			status = "na";
			phys = <&sataphy0>;
			phy-names = "sataphy1f210000";
		};

		sata1: sata@1a400000 {
			compatible = "apm,xgene-ahci";
			reg =  <0x0 0x1a400000 0x0 0x100000
				0x0 0x1f220000 0x0 0x10000>;
			interrupt-parent = <&gic>;
			interrupts = <0x0 0x87 0x4>;
			status = "ok";
			phys = <&sataphy1>;
			phy-names = "sataphy1f220000";
		};

		sata2: sata@1a800000 {
			compatible = "apm,xgene-ahci";
			reg =  <0x0 0x1a800000 0x0 0x100000
				0x0 0x1f230000 0x0 0x10000>;
			interrupt-parent = <&gic>;
			interrupts = <0x0 0x88 0x4>;
			status = "ok";
			phys = <&sataphy2>;
			phy-names = "sataphy1f230000";
		};
```

## Documentation/devicetree/bindings/edac/apm-xgene-edac.txt
```
* APM X-Gene SoC EDAC nodes

EDAC nodes are defined to describe on-chip error detection and correction.
There are four types of EDAC:

  memory controller	- Memory controller
  PMD (L1/L2)		- Processor module unit (PMD) L1/L2 cache
  L3			- CPU L3 cache
  SoC			- SoC IP such as SATA, Ethernet, and etc

The following section describes the memory controller DT node binding.

Required properties:
- compatible		: Shall be "apm,xgene-edac-mc".
- reg			: First resource shall be the PCP resource.
			  Second resource shall be the CSW resource.
			  Third resource shall be the MCB-A resource.
			  Fourth resource shall be the MCB-B resource.
			  Fifth resource shall be the MCU resource.
- interrupts            : Interrupt-specifier for MCU error IRQ(s).

The following section describes the L1/L2 DT node binding.

- compatible		: Shall be "apm,xgene-edac-pmd".
- reg			: First resource shall be the PCP resource.
			  Second resource shall be the PMD resource.
			  Third resource shall be the PMD efuse resource.
- interrupts            : Interrupt-specifier for PMD error IRQ(s).

The following section describes the L3 DT node binding.

- compatible		: Shall be "apm,xgene-edac-l3".
- reg			: First resource shall be the PCP resource.
			  Second resource shall be the L3 resource.
- interrupts            : Interrupt-specifier for L3 error IRQ(s).

The following section describes the SoC DT node binding.

- compatible		: Shall be "apm,xgene-edac-soc"".
- reg			: First resource shall be the PCP resource.
			  Second resource shall be the SoC resource.
			  Third resource shall be the register bus resource.
- interrupts		: Interrupt-specifier for SoC error IRQ(s).

Example:
	edacmc0: edacmc0@7e800000 {
		compatible = "apm,xgene-edac-mc";
		reg = <0x0 0x78800000 0x0 0x1000>,
		      <0x0 0x7e200000 0x0 0x1000>,
		      <0x0 0x7e700000 0x0 0x1000>,
		      <0x0 0x7e720000 0x0 0x1000>,
		      <0x0 0x7e800000 0x0 0x1000>;
		interrupts = <0x0 0x20 0x4>,
			     <0x0 0x21 0x4>;
	};

	edacl3: edacl3@7e600000 {
		compatible = "apm,xgene-edac-l3";
		reg = <0x0 0x78800000 0x0 0x1000>,
		      <0x0 0x7e600000 0x0 0x1000>;
		interrupts = <0x0 0x20 0x4>,
			     <0x0 0x21 0x4>;
	};

	edacpmd0: edacpmd0@7c000000 {
		compatible = "apm,xgene-edac-pmd";
		reg = <0x0 0x78800000 0x0 0x1000>,
		      <0x0 0x7c000000 0x0 0x200000>,
		      <0x0 0x1054a000 0x0 0x10>;
		interrupts = <0x0 0x20 0x4>,
			     <0x0 0x21 0x4>;
	};

	edacsoc: edacsoc@7e930000 {
		compatible = "apm,xgene-edac-soc";
		reg = <0x0 0x78800000 0x0 0x1000>,
		      <0x0 0x7e930000 0x0 0x1000>,
		      <0x0 0x7e000000 0x0 0x1000>;
		interrupts = <0x0 0x20 0x4>,
			     <0x0 0x21 0x4>,
			     <0x0 0x27 0x4>;
	};
```

## Documentation/devicetree/bindings/gpio/gpio-xgene.txt
```
APM X-Gene SoC GPIO controller bindings

This is a gpio controller that is part of the flash controller.
All registers are 32bit and in little endian format.

There are three flash controller gpio banks, each bank have 16
gpio pins.

Required properties:
- compatible: "apm,xgene-gpio" for X-Gene GPIO controller
- reg: Physical base address and size of the controller's registers
- #gpio-cells: Should be two.
	- first cell is the pin number
	- second cell is used to specify optional parameters (unused)
- gpio-controller: Marks the device node as a GPIO controller.

Example:
	gpio0: gpio0@1701c00c {
		compatible = "apm,xgene-gpio";
		reg = <0x0 0x1701c00c 0x0 0x30>;
		gpio-controller;
		#gpio-cells = <2>;
	};

	gpio1: gpio1@1701c018 {
		compatible = "apm,xgene-gpio";
		reg = <0x0 0x1701c018 0x0 0x30>;
		gpio-controller;
		#gpio-cells = <2>;
	};

	gpio2: gpio2@1701c024 {
		compatible = "apm,xgene-gpio";
		reg = <0x0 0x1701c024 0x0 0x30>;
		gpio-controller;
		#gpio-cells = <2>;
	};
```

## Documentation/devicetree/bindings/mailbox/xgene-slimpro-mailbox.txt
```
The APM X-Gene SLIMpro mailbox driver is used to communicate messages between
the ARM64 processors and the Cortex M3 (dubbed SLIMpro). It uses a simple
interrupt based door bell mechanism and can exchange simple messages using the
internal registers.

There are total of 8 interrupts in this mailbox. Each used for an individual
door bell (or mailbox channel).

Required properties:
- compatible:	Should be as "apm, xgene-slimpro-mbox".

- reg:		Contain the mailbox register address range.

- interrupts:	Contain interrupt information for the mailbox device.

- #mbox-cells:	Specify the number of parameters used by the mailbox client.
		Currently only one to specify the mailbox channel number.

Example:

Mailbox Node:
		mailbox: slimpro-mailbox@10540000 {
			compatible = "apm,xgene-slimpro-mbox";
			reg = <0x0 0x10540000 0x0 0xa000>;
			#mbox-cells = <1>;
			interrupts =  	<0x0 0x0 0x4>,
					<0x0 0x1 0x4>,
					<0x0 0x2 0x4>,
					<0x0 0x3 0x4>,
					<0x0 0x4 0x4>,
					<0x0 0x5 0x4>,
					<0x0 0x6 0x4>,
					<0x0 0x7 0x4>;
		};

Client Node:
		i2cslimpro {
			compatible = "apm,xgene-slimpro-i2c";
			mbox = <&mailbox 0>;
			mbox-names = "i2c-slimpro";
		};
```

## Documentation/devicetree/bindings/mmc/arasan,sdhci.txt
```
Device Tree Bindings for the Arasan SDHCI Controller

  The bindings follow the mmc[1], clock[2] and interrupt[3] bindings. Only
  deviations are documented here.

  [1] Documentation/devicetree/bindings/mmc/mmc.txt
  [2] Documentation/devicetree/bindings/clock/clock-bindings.txt
  [3] Documentation/devicetree/bindings/interrupt-controller/interrupts.txt

Required Properties:
  - compatible: Compatibility string. Must be 'arasan,sdhci-8.9a' or
                'apm,arasan,sdhci-8.9a'
  - reg: First resource is the SDHC register location and length.
         Second optional resource is the bridge translation register location
         and length if required.
  - interrupts: Interrupt specifier
  - interrupt-parent: Phandle for the interrupt controller that services
		      interrupts for this device.

Optional Properties:
  - clocks: For format, refer to clock bindings. It requires two clocks if
            specified - AHB clock and SDHC clock.
  - clock-names: For format, refer to clock bindings. The clock corresponding
                 to the AHBC clock must be named "clk_ahb". The clock
                 corresponding to the SDHC clock must be named "clk_xin".

Example:
	sdhci@e0100000 {
		compatible = "arasan,sdhci-8.9a";
		reg = <0xe0100000 0x1000>;
		clock-names = "clk_xin", "clk_ahb";
		clocks = <&clkc 21>, <&clkc 32>;
		interrupt-parent = <&gic>;
		interrupts = <0 24 4>;
	} ;
```

## Documentation/devicetree/bindings/net/apm-xgene-enet.txt
```
APM X-Gene SoC Ethernet nodes

Ethernet nodes are defined to describe on-chip ethernet interfaces in
APM X-Gene SoC.

Required properties:
- compatible:		Should be "apm,xgene-enet"
- reg:			First resource is the ethernet base register set
			Second resource is the ring base register set
			Third resource is the ring command register set
- interrupts:		Ethernet main interrupt
- clocks:		Reference to the clock entry.
- local-mac-address:	Ethernet MAC address.
- phy-connection-type:	Ethernet MII mode.

- mdio device tree subnode: When the X-Gene SoC has a phy connected to its local
		mdio, there must be device tree subnode with the following
		required properties:

	- compatible: Must be "apm,xgene-mdio".
	- #address-cells: Must be <1>.
	- #size-cells: Must be <0>.

	For the phy on the mdio bus, there must be a node with the following
	fields:

	- reg: phy id used to communicate to phy.

Optional properties:
- status		: Should be "ok" or "disabled" for enabled/disabled.
			  Default is "ok".

Example:
	menetclk: menetclk {
		compatible = "apm,xgene-device-clock";
		clock-output-names = "menetclk";
		status = "ok";
	};

	menet: ethernet@17020000 {
		compatible = "apm,xgene-enet";
		status = "disabled";
		reg = <0x0 0x17020000 0x0 0xd100>,
		      <0x0 0X17030000 0x0 0X400>,
		      <0x0 0X10000000 0x0 0X200>;
		interrupts = <0x0 0x3c 0x4>;
		clocks = <&menetclk 0>;
		local-mac-address = [00 01 73 00 00 01];
		phy-connection-type = "rgmii";
		phy-handle = <&menetphy>;
		mdio {
			compatible = "apm,xgene-mdio";
			#address-cells = <1>;
			#size-cells = <0>;
			menetphy: menetphy@3 {
				reg = <0x3>;
			};

		};
	};

/* Board-specific peripheral configurations */

&menet {
        status = "ok";
};
```

## arch/arm64/configs/xgene_xen_defconfig
```kconfig
# CONFIG_LOCALVERSION_AUTO is not set
CONFIG_SYSVIPC=y
CONFIG_POSIX_MQUEUE=y
CONFIG_NO_HZ=y
CONFIG_HIGH_RES_TIMERS=y
CONFIG_BSD_PROCESS_ACCT=y
CONFIG_BSD_PROCESS_ACCT_V3=y
CONFIG_IKCONFIG=y
CONFIG_IKCONFIG_PROC=y
CONFIG_LOG_BUF_SHIFT=14
# CONFIG_UTS_NS is not set
# CONFIG_IPC_NS is not set
# CONFIG_PID_NS is not set
# CONFIG_NET_NS is not set
CONFIG_SCHED_AUTOGROUP=y
CONFIG_BLK_DEV_INITRD=y
# CONFIG_COMPAT_BRK is not set
CONFIG_PROFILING=y
CONFIG_JUMP_LABEL=y
CONFIG_MODULES=y
CONFIG_MODULE_UNLOAD=y
# CONFIG_BLK_DEV_BSG is not set
# CONFIG_IOSCHED_DEADLINE is not set
CONFIG_ARCH_VEXPRESS=y
CONFIG_ARCH_XGENE=y
CONFIG_PCI=y
CONFIG_PCI_XGENE=y
CONFIG_SMP=y
CONFIG_PREEMPT=y
CONFIG_CMA=y
CONFIG_XEN=y
CONFIG_CMDLINE="console=ttyAMA0"
# CONFIG_CORE_DUMP_DEFAULT_ELF_HEADERS is not set
CONFIG_COMPAT=y
CONFIG_NET=y
CONFIG_PACKET=y
CONFIG_UNIX=y
CONFIG_INET=y
CONFIG_IP_PNP=y
CONFIG_IP_PNP_DHCP=y
CONFIG_IP_PNP_BOOTP=y
# CONFIG_INET_LRO is not set
# CONFIG_IPV6 is not set
CONFIG_BRIDGE=y
# CONFIG_WIRELESS is not set
CONFIG_UEVENT_HELPER_PATH="/sbin/hotplug"
CONFIG_DEVTMPFS=y
CONFIG_DEVTMPFS_MOUNT=y
CONFIG_DMA_CMA=y
CONFIG_BLK_DEV_LOOP=y
CONFIG_BLK_DEV_RAM=y
CONFIG_BLK_DEV_RAM_SIZE=16384
CONFIG_XEN_BLKDEV_BACKEND=y
CONFIG_VIRTIO_BLK=y
# CONFIG_SCSI_PROC_FS is not set
CONFIG_BLK_DEV_SD=y
# CONFIG_SCSI_LOWLEVEL is not set
CONFIG_ATA=y
CONFIG_SATA_AHCI=y
CONFIG_SATA_AHCI_PLATFORM=y
CONFIG_AHCI_XGENE=y
CONFIG_PATA_PLATFORM=y
CONFIG_PATA_OF_PLATFORM=y
CONFIG_MD=y
CONFIG_BLK_DEV_DM=y
CONFIG_DM_MULTIPATH=y
CONFIG_DM_UEVENT=y
CONFIG_NETDEVICES=y
CONFIG_TUN=y
CONFIG_VIRTIO_NET=y
CONFIG_NET_XGENE=y
CONFIG_E1000=y
CONFIG_E1000E=y
CONFIG_IGB=y
CONFIG_SMC91X=y
CONFIG_SMSC911X=y
# CONFIG_WLAN is not set
CONFIG_XEN_NETDEV_BACKEND=y
CONFIG_INPUT_EVDEV=y
# CONFIG_SERIO_SERPORT is not set
CONFIG_DEVPTS_MULTIPLE_INSTANCES=y
CONFIG_LEGACY_PTY_COUNT=16
CONFIG_SERIAL_8250=y
CONFIG_SERIAL_8250_CONSOLE=y
CONFIG_SERIAL_AMBA_PL011=y
CONFIG_SERIAL_AMBA_PL011_CONSOLE=y
CONFIG_SERIAL_OF_PLATFORM=y
CONFIG_VIRTIO_CONSOLE=y
# CONFIG_HW_RANDOM is not set
CONFIG_GPIO_GENERIC_PLATFORM=y
CONFIG_GPIO_XGENE=y
# CONFIG_HWMON is not set
CONFIG_REGULATOR=y
CONFIG_REGULATOR_FIXED_VOLTAGE=y
CONFIG_FB=y
CONFIG_FRAMEBUFFER_CONSOLE=y
CONFIG_LOGO=y
# CONFIG_LOGO_LINUX_MONO is not set
# CONFIG_LOGO_LINUX_VGA16 is not set
CONFIG_USB=y
CONFIG_USB_ISP1760_HCD=y
CONFIG_USB_STORAGE=y
CONFIG_MMC=y
CONFIG_MMC_ARMMMCI=y
CONFIG_NEW_LEDS=y
CONFIG_LEDS_CLASS=y
CONFIG_LEDS_TRIGGERS=y
CONFIG_VIRTIO_MMIO=y
CONFIG_VIRTIO_MMIO_CMDLINE_DEVICES=y
CONFIG_XEN_GNTDEV=y
CONFIG_XEN_GRANT_DEV_ALLOC=y
# CONFIG_IOMMU_SUPPORT is not set
CONFIG_PHY_XGENE=y
CONFIG_EXT2_FS=y
CONFIG_EXT3_FS=y
# CONFIG_EXT3_DEFAULTS_TO_ORDERED is not set
# CONFIG_EXT3_FS_XATTR is not set
CONFIG_EXT4_FS=y
CONFIG_FUSE_FS=y
CONFIG_CUSE=y
CONFIG_VFAT_FS=y
CONFIG_TMPFS=y
CONFIG_HUGETLBFS=y
# CONFIG_MISC_FILESYSTEMS is not set
CONFIG_NFS_FS=y
CONFIG_ROOT_NFS=y
CONFIG_NLS_CODEPAGE_437=y
CONFIG_NLS_ISO8859_1=y
CONFIG_VIRTUALIZATION=y
CONFIG_KVM=y
CONFIG_DEBUG_FS=y
CONFIG_MAGIC_SYSRQ=y
CONFIG_ATOMIC64_SELFTEST=y
CONFIG_XZ_DEC_X86=y
CONFIG_XZ_DEC_POWERPC=y
CONFIG_XZ_DEC_IA64=y
CONFIG_XZ_DEC_ARM=y
CONFIG_XZ_DEC_ARMTHUMB=y
CONFIG_XZ_DEC_SPARC=y
```

## drivers/pci/apm/Kconfig
```kconfig
config	APM88XXXX_PCI
	bool "APM88XXX PCIe platform driver"
	depends on PCI
	default y
	help
	  Enable APM88XXXX PCIe platform driver for
	  2x, 4x, 8x / GEN1, GEN2, GEN3 PCIe Root Complex
	  and Endpoints.
```
