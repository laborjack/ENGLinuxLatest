## drivers/pci/host/Kconfig
```kconfig
menu "PCI host controller drivers"
	depends on PCI

config PCI_MVEBU
	bool "Marvell EBU PCIe controller"
	depends on ARCH_MVEBU || ARCH_KIRKWOOD

config PCIE_DW
	bool

config PCI_EXYNOS
	bool "Samsung Exynos PCIe controller"
	depends on SOC_EXYNOS5440
	select PCIEPORTBUS
	select PCIE_DW

config  PCI_XGENE
        bool "X-Gene PCIe controller"
        depends on PCI
        default y
        help
          Enable X-Gene PCIe controller
          2x, 4x, 8x / GEN1, GEN2, GEN3 PCIe Root Complex
          and Endpoints.

endmenu
```
